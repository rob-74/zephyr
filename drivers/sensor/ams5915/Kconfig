## drivers/sensor/ams5915/Kconfig
```kconfig
# AMS5915 pressure and temperature sensor configuration options

# SPDX-License-Identifier: Apache-2.0

menuconfig AMS5915
	bool "AMS 5915 is a series of high precision, digital pressure sensors"
	default y
	depends on DT_HAS_ANAMICRO_AMS5915_ENABLED
	select I2C
	help
	  Enable driver for AMS5915 I2C-based pressure and temperature sensor.

# if AMS5915

# choice
# 	prompt "AMS5915 sensor variant"
# 	default AMS5915_VARIANT_0005_D_N
# 	help
# 	  Select sensor variant. Please check the data sheet for further details.

# config AMS5915_VARIANT_0005_D_N	
# 	bool "AMS5915-0005-D-N"

# config AMS5915_VARIANT_0010_D_N	
# 	bool "AMS5915-0010-D-B-N"

# config AMS5915_VARIANT_0002_D_B_N	
# 	bool "AMS5915-0003-D-B-N"

# config AMS5915_VARIANT_0005_D_B_N	
# 	bool "AMS5915-0005-D-B-N"

# config AMS5915_VARIANT_0010_D_B_N	
# 	bool "AMS5915-0010-D-B-N"

# config AMS5915_VARIANT_0020_D_N	
# 	bool "AMS5915-0020-D-N"

# config AMS5915_VARIANT_0050_D_N	
# 	bool "AMS5915-0050-D-N"

# config AMS5915_VARIANT_0100_D_N	
# 	bool "AMS5915-0100-D-N"

# config AMS5915_VARIANT_0020_D_B_N	
# 	bool "AMS5915-0020-D-B-N"

# config AMS5915_VARIANT_0050_D_B_N	
# 	bool "AMS5915-0050-D-B-N"

# config AMS5915_VARIANT_0100_D_B_N	  
# 	bool "AMS5915-0100-D-B-N"

# config AMS5915_VARIANT_0200_D_N	
# 	bool "AMS5915-0200-D-N"

# config AMS5915_VARIANT_0350_D_N	
# 	bool "AMS5915-0350-D-N"

# config AMS5915_VARIANT_1000_D_N	
# 	bool "AMS5915-1000-D-N"

# config AMS5915_VARIANT_2000_D_N	
# 	bool "AMS5915-2000-D-N"

# config AMS5915_VARIANT_4000_D_N	
# 	bool "AMS5915-4000-D-N"

# config AMS5915_VARIANT_7000_D_N	
# 	bool "AMS5915-7000-D-N"

# config AMS5915_VARIANT_10000_D_N	
# 	bool "AMS5915-10000-D-N"

# config AMS5915_VARIANT_0200_D_B_N	
# 	bool "AMS5915-0200-D-B-N"

# config AMS5915_VARIANT_0350_D_B_N	
# 	bool "AMS5915-0350-D-B-N"

# config AMS5915_VARIANT_1000_D_B_N	 
# 	bool "AMS5915-1000-D-B-N"

# config AMS5915_VARIANT_4000_D_I_N  
# 	bool "AMS5915-4000-D-I-N"

# config AMS5915_VARIANT_7000_D_I_N  
# 	bool "AMS5915-7000-D-I-N"

# config AMS5915_VARIANT_10000_D_I_N	
# 	bool "AMS5915-10000-D-I-N"

# config AMS5915_VARIANT_12000_D_I_N	
# 	bool "AMS5915-12000-D-I-N"

# config AMS5915_VARIANT_16000_D_I_N	
# 	bool "AMS5915-16000-D-I-N"
	
# endchoice

# endif # AMS5915
```

## dts/bindings/sensor/anamicro,ams5915.yaml
```yaml
# SPDX-License-Identifier: Apache-2.0

description: AMS5915 pressure and temperature sensor

compatible: "anamicro,ams5915"

include: [sensor-device.yaml, i2c-device.yaml]

properties:
  variant:
    type: int
    required: true
    description: |
      AMS 5915 Sensor Variant
    enum:
      - 0 # AMS5915_0005_D_N
      - 1 # AMS5915_0010_D_N
      - 2 # AMS5915_0002_D_B_N
      - 3 # AMS5915_0005_D_B_N
      - 4 # AMS5915_0010_D_B_N
      - 5 # AMS5915_0020_D_N
      - 6 # AMS5915_0050_D_N
      - 7 # AMS5915_0100_D_N
      - 8 # AMS5915_0020_D_B_N
      - 9 # AMS5915_0050_D_B_N
      - 10 # AMS5915_0100_D_B_N
      - 11 # AMS5915_0200_D_N
      - 12 # AMS5915_0350_D_N
      - 13 # AMS5915_1000_D_N
      - 14 # AMS5915_2000_D_N
      - 15 # AMS5915_4000_D_N
      - 16 # AMS5915_7000_D_N
      - 17 # AMS5915_1000_D_N
      - 18 # AMS5915_0200_D_B_N
      - 19 # AMS5915_0350_D_B_N
      - 20 # AMS5915_1000_D_B_N
      - 21 # AMS5915_4000_D_I_N
      - 22 # AMS5915_7000_D_I_N
      - 23 # AMS5915_10000_D_I_N
      - 24 # AMS5915_12000_D_I_N
      - 25 # AMS5915_16000_D_I_N
```

## samples/sensor/ams5915/sample.yaml
```yaml
sample:
  name: AMS5915 Sensor sample
tests:
  sample.sensor.ams59125:
    harness: console
    tags: sensors
    filter: dt_compat_enabled("anamicro,ams5915")
    harness_config:
      type: one_line
      regex:
        - "temp: (.*); press: (.*);"
      fixture: fixture_i2c_ams5915
```
